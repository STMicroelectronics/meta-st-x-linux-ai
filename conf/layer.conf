## conf/layer.conf
```bitbake
# We have a conf and classes directory, add to BBPATH
BBPATH .= ":${LAYERDIR}"

# Add recipes to to BBFILES
BBFILES += " ${LAYERDIR}/recipes-*/*/*.bb "
BBFILES += " ${LAYERDIR}/recipes-*/*/*/*.bb "
BBFILES += " ${LAYERDIR}/recipes-*/*/*.bbappend* "

BBFILE_COLLECTIONS += "x-linux-ai"
BBFILE_PATTERN_x-linux-ai := "^${LAYERDIR}/"
BBFILE_PRIORITY_x-linux-ai = "5"

# This should only be incremented on significant changes that will
# cause compatibility issues with other layers
LAYERVERSION_x-linux-ai = "1"
LAYERSERIES_COMPAT_x-linux-ai = "scarthgap"

LAYERDEPENDS_x-linux-ai  = "stm-st-stm32mp"
LAYERDEPENDS_x-linux-ai += "st-openstlinux"

ST_OSTL_COMPATIBILITY_VERSION_x-linux-ai = "6.0"
```
